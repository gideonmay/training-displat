/*
 * Copyright (c) 2021 Nordic Semiconductor ASA
 * SPDX-License-Identifier: Apache-2.0
 */

/* This devicetree overlay file will be automatically picked by the Zephyr
 * build system when building the sample for the arduino_nano_33_iot board. It shows
 * how the training-display can be built on sample boards already provided
 * by Zephyr.
 */

/ {
	examplesensor0: examplesensor_0 {
		compatible = "zephyr,examplesensor";
		input-gpios = <&gpioc 12 (GPIO_PULL_UP | GPIO_ACTIVE_LOW)>;
	};
};

&gpioc {
	status = "okay";
};
